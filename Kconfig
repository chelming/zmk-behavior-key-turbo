## Kconfig
```kconfig
# Key Turbo behavior
#
# Copyright (c) 2023 The ZMK Contributors
#
# SPDX-License-Identifier: MIT
#

DT_COMPAT_ZMK_BEHAVIOR_KEY_TURBO := zmk,behavior-key-turbo

config ZMK_BEHAVIOR_KEY_TURBO
    bool
    default $(dt_compat_enabled,$(DT_COMPAT_ZMK_BEHAVIOR_KEY_TURBO))
```

## dts/bindings/zmk,behavior-key-turbo.yaml
```yaml
# Copyright (c) 2021 The ZMK Contributors
# SPDX-License-Identifier: MIT

description: Key Turbo behavior

compatible: "zmk,behavior-key-turbo"

include: one_param.yaml

properties:
  bindings:
    type: phandles
    required: true
    description: Behavior to activate (typically &kp)
  tapping-term-ms:
    type: int
    required: true
    description: Delay in milliseconds before starting the turbo
  pause-ms:
    type: int
    required: true
    description: Time to wait between key presses in milliseconds
  press-ms:
    type: int
    required: true
    description: How long the key should be held during each cycle
```
